## package/bcm-refsw/Config.in
```kconfig
menuconfig BR2_PACKAGE_BCM_REFSW
	bool "bcm-refsw"
	select BR2_PACKAGE_HAS_OPENGL_EGL
	select BR2_PACKAGE_HAS_OPENGL_ES
	select BR2_PACKAGE_HAS_OPENVG
	help
	  Broadcom Reference Software

if BR2_PACKAGE_BCM_REFSW

config BR2_PACKAGE_BCM_REFSW_PLATFORM
	string "Broadcom target platform"

config BR2_PACKAGE_BCM_REFSW_PLATFORM_REV
	string "Broadcom target platform revision"

endif
```

## package/glexamples/Config.in
```kconfig
config BR2_PACKAGE_GLEXAMPLES
	bool "glexamples"
	help
	  Metrological's (accelerated) examples
	  http://www.metrological.com
```

## package/gobject-introspection/Config.in
```kconfig
config BR2_PACKAGE_GOBJECT_INTROSPECTION
	bool "gobject-introspection"
	help
	  Introspection for GObject libraries.
	  Installs only m4 file to staging!!!
```

## package/mlbrowser/Config.in
```kconfig
config BR2_PACKAGE_MLBROWSER
	bool "mlbrowser"
	help
	  Metrological's simple (accelerated) browser implementation
	  http://www.metrological.com
```

## package/multimedia/dxdrm/Config.in
```kconfig
config BR2_PACKAGE_DXDRM
	bool "dxdrm"
	help
	  Discretix PlayReady DRM implementation

	  http://www.metrological.com
```

## package/multimedia/gst-fludash/Config.in
```kconfig
config BR2_PACKAGE_GST_FLUDASH
	bool "gst-fludash"
	depends on BR2_PACKAGE_GST_FLUCODECPACK
	help
	  GStreamer RPI DASH plug-in.

	  http://www.metrological.com
```

## package/qt5/examples/Config.in
```kconfig
config BR2_PACKAGE_EXAMPLES
	bool "examples"
	help
	  Metrological's (accelerated) examples
	  http://www.metrological.com
```

## package/qt5/qt5quick1/Config.in
```kconfig
config BR2_PACKAGE_QT5QUICK1
	bool "qt5quick1"
	select BR2_PACKAGE_QT5BASE
	select BR2_PACKAGE_QT5SCRIPT
	select BR2_PACKAGE_QT5SVG
	select BR2_PACKAGE_QT5XMLPATTERNS
	select BR2_PACKAGE_QT5DECLARATIVE
	select BR2_PACKAGE_QT5WEBKIT
	depends on !BR2_PREFER_STATIC_LIB
	depends on BR2_PACKAGE_HAS_OPENGL_EGL
	depends on BR2_PACKAGE_HAS_OPENGL_ES
	help
	  Qt is a cross-platform application and UI framework for
	  developers using C++.

	  This package corresponds to the qt5quick1 module.

	  http://qt-project.org
```

## package/qt5/qt5webkit/Config.in
```kconfig
config BR2_PACKAGE_QT5WEBKIT
	bool "qt5webkit"
	select BR2_PACKAGE_QT5BASE
	select BR2_PACKAGE_QT5BASE_ICU
	select BR2_PACKAGE_QT5BASE_NETWORK
	select BR2_PACKAGE_QT5BASE_GUI
	select BR2_PACKAGE_QT5BASE_WIDGETS
	select BR2_PACKAGE_SQLITE
	# This module does not support static linking
	depends on !BR2_PREFER_STATIC_LIB
	depends on BR2_PACKAGE_QT5_JSCORE_AVAILABLE
	help
	  Qt is a cross-platform application and UI framework for
	  developers using C++.

	  This package corresponds to the qt5webkit module.

	  http://qt-project.org

menu "Extra options"

config BR2_PACKAGE_MINIBROWSER
	bool "minibrowser"
	depends on BR2_PACKAGE_QT5DECLARATIVE

config BR2_PACKAGE_TESTBROWSER
	bool "testbrowser"

config BR2_PACKAGE_DUMPRENDERTREE
	bool "dumprendertree"

endmenu
```
